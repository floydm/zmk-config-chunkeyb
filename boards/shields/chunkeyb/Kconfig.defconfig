## boards/shields/chunkeyb/Kconfig.defconfig
```kconfig
if SHIELD_CHUNKEYB_LEFT

config ZMK_KEYBOARD_NAME
    default "Chunkeyb"

config ZMK_SPLIT_ROLE_CENTRAL
    default y

endif


if SHIELD_CHUNKEYB_LEFT || SHIELD_CHUNKEYB_RIGHT

config ZMK_SPLIT
    default y

endif
```

## boards/shields/chunkeyb/Kconfig.shield
```kconfig
config SHIELD_CHUNKEYB_LEFT
    def_bool $(shields_list_contains,chunkeyb_left)

config SHIELD_CHUNKEYB_RIGHT
    def_bool $(shields_list_contains,chunkeyb_right)
```
